## zephyr/Kconfig
```kconfig
# SPDX-License-Identifier: MIT

config LIBVRT
	bool "libvrt VITA 49 Radio Transport packets"
	help
	  Encoder and decoder for ANSI/VITA 49 Radio Transport (VRT) packets.
	  Words are read and written in CPU byte order; swap them to big
	  endian for standard conforming packets on little endian CPUs.
```

## zephyr/tests/vrt/testcase.yaml
```yaml
common:
  tags: libvrt
  integration_platforms:
    - xiao_esp32s3/esp32s3/procpu
tests:
  libraries.libvrt: {}
```
